## prj.conf
```kconfig
#
# Copyright (c) 2020 Nordic Semiconductor ASA
#
# SPDX-License-Identifier: LicenseRef-Nordic-5-Clause
#

# Logging
CONFIG_LOG=y

# Button and LED support
CONFIG_DK_LIBRARY=y

# Newlib
CONFIG_NEWLIB_LIBC=y

# Networking
CONFIG_NETWORKING=y
CONFIG_NET_NATIVE=n
CONFIG_NET_SOCKETS_OFFLOAD=y
CONFIG_NET_SOCKETS=y
CONFIG_NET_SOCKETS_POSIX_NAMES=y

# Memory
CONFIG_MAIN_STACK_SIZE=4096
CONFIG_HEAP_MEM_POOL_SIZE=2048

# Modem library
CONFIG_NRF_MODEM_LIB=y

# LTE link control
CONFIG_LTE_LINK_CONTROL=y
CONFIG_LTE_AUTO_INIT_AND_CONNECT=n
CONFIG_LTE_NETWORK_MODE_NBIOT=y

# MQTT
# STEP 2.1 - Enable and configure the MQTT library 
CONFIG_MQTT_LIB=y
CONFIG_MQTT_CLEAN_SESSION=y

# Application
# STEP 2.2 - Configure the broker name, TCP port, topic names, and message
CONFIG_MQTT_PUB_TOPIC="devacademy/publish/topic"
CONFIG_MQTT_SUB_TOPIC="devacademy/subscribe/topic"
CONFIG_BUTTON_EVENT_PUBLISH_MSG="Hi from the nRF9160 SiP"
CONFIG_MQTT_BROKER_HOSTNAME="test.mosquitto.org"
CONFIG_MQTT_BROKER_PORT=1883
```

## src/main.c
```c
/********************************************************************************
 * Copyright (c) 2018 Nordic Semiconductor ASA
 *
 * SPDX-License-Identifier: LicenseRef-Nordic-5-Clause
 ********************************************************************************/
#include <stdio.h>
#include <zephyr/kernel.h>
#include <zephyr/net/socket.h>
#include <zephyr/drivers/gpio.h>
#include <zephyr/device.h>
#include <zephyr/devicetree.h>
#include <zephyr/drivers/gpio.h>
#include <zephyr/drivers/sensor.h>
#include <zephyr/sys/printk.h>
#include <zephyr/sys/__assert.h>
#include <string.h>
#include <zephyr/logging/log.h>
#include <dk_buttons_and_leds.h>
#include <modem/lte_lc.h>
/* STEP 2.3 - Include the header file for the MQTT Library*/
#include <zephyr/net/mqtt.h>

#include "mqtt_connection.h"

/********************************************************************************
 *
 ********************************************************************************/
#define OPEN_VALVE 			1
#define CLOSE_VALVE 		0
#define VALVE_OPENED		1
#define VALVE_CLOSED		0

#define HIGH 				1
#define LOW 				0

#define ON 					1
#define OFF 				0

#define MOTION_DETECTOR 13 /*  */

#define WATER_VALVE 		16 /*  */
#define BUZZER 				28	   /* sig pin of the buzzer */
#define LIGHTWELL_RED_LED 	29
#define LIGHTWELL_GREEN_LED 30
#define LIGHTWELL_BLUE_LED 	31

#define MAX_OUTPUTS 		5
#define MAX_INPUTS 			1

/* 1000 msec = 1 sec */
#define SLEEP_TIME_MS 		1000
#define SLEEP_TIME_S		1000
#define SLEEP_TIME_HALF_S	500
#define SLEEP_TIME_QUOTA_S	250

#define APP_EVENT_QUEUE_SIZE 20

/* Option 1: by node label */
#define MY_GPIO0 DT_NODELABEL(gpio0)

/********************************************************************************
 *
 ********************************************************************************/
enum led_id_t
{
	LIGHTWELL_RED = 0,
	LIGHTWELL_GREEN = 1,
	LIGHTWELL_BLUE = 2
};

enum app_event_type
{
	APP_EVENT_TIMER,
	APP_EVENT_ERROR,
	APP_EVENT_SENSOR_DATA,
};

struct app_event
{
	enum app_event_type type;
	uint32_t value;
};

/********************************************************************************
 *
 ********************************************************************************/
static uint8_t valve_status = VALVE_CLOSED;
static uint32_t output_gpio[MAX_OUTPUTS] = {WATER_VALVE, BUZZER, LIGHTWELL_RED,
											LIGHTWELL_GREEN, LIGHTWELL_BLUE};
static uint32_t input_gpio[MAX_INPUTS] = {MOTION_DETECTOR};
/* The mqtt client struct */
static struct mqtt_client client;
/* File descriptor */
static struct pollfd fds;
//
static K_SEM_DEFINE(lte_connected, 0, 1);
// const struct device *gpio_dev;
const struct device *gpio_dev = DEVICE_DT_GET(MY_GPIO0);
//
struct k_timer my_timer;
struct k_timer main_timer;
// extern void my_expiry_function(struct k_timer *timer_id);
static struct gpio_callback motion_cb_data;
//
struct k_msgq app_msgq;

/************************************************************************
 *
 ************************************************************************/
LOG_MODULE_REGISTER(a_smart_water_tap_v1, LOG_LEVEL_INF);

/********************************************************************************
 * Play tone
 ********************************************************************************/
void beep_buzzer(int tone, int duration);
void motion_detected(const struct device *dev, struct gpio_callback *cb, uint32_t pins);
void my_expiry_function(struct k_timer *timer_id);
void blink_leds(uint32_t on_sleep_ms, uint32_t off_sleep_ms,enum led_id_t id, uint32_t numOfBlinks);
void configuer_all_inputs(void);
void configuer_all_outputs(void);

/********************************************************************************
 *
 ********************************************************************************/
void blink_leds(uint32_t on_sleep_ms, uint32_t off_sleep_ms,enum led_id_t id, uint32_t numOfBlinks)
{
	uint32_t i = 0;

	switch(id)
	{
		case LIGHTWELL_RED:
		{	
			for(i = 0; i < numOfBlinks; i++) 
			{	
				dk_set_led_on(DK_LED1);
				k_msleep(on_sleep_ms);
				dk_set_led_off(DK_LED1);
				k_msleep(off_sleep_ms);
			}
		}
		break;
		
		case LIGHTWELL_GREEN:
		{	
			for(i = 0; i < numOfBlinks; i++)
			{
				dk_set_led_on(DK_LED2);
				k_msleep(on_sleep_ms);
				dk_set_led_off(DK_LED2);
				k_msleep(off_sleep_ms);
			}
		break;
		}
		case LIGHTWELL_BLUE:
		{
			for(i = 0; i < numOfBlinks; i++)
			{
				dk_set_led_on(DK_LED3);
				k_msleep(on_sleep_ms);
				dk_set_led_off(DK_LED3);
				k_msleep(off_sleep_ms);
			}
		}
		break;

		default:
		break;
	}
}

/********************************************************************************
 * Play tone
 ********************************************************************************/
void beep_buzzer(int tone, int duration)
{
	for (long i = 0; i < duration * 1000L; i += tone * 2)
	{
		gpio_pin_set(gpio_dev, BUZZER, HIGH);
		k_msleep(tone);
		gpio_pin_set(gpio_dev, BUZZER, LOW);
		k_msleep(tone);
	}
}

/********************************************************************************
 *
 ********************************************************************************/
void configuer_all_outputs(void)
{
	int err;
	for (uint32_t i = 0; i < MAX_OUTPUTS; i++)
	{
		if (!device_is_ready(gpio_dev))
		{
			return;
		}

		err = gpio_pin_configure(gpio_dev, output_gpio[i], GPIO_OUTPUT_INACTIVE);
		if (err < 0)
		{
			return;
		}
	}
}

/********************************************************************************
 *
 ********************************************************************************/
void configuer_all_inputs(void)
{
	int err;
	for (uint32_t i = 0; i < MAX_INPUTS; i++)
	{
		if (!device_is_ready(gpio_dev))
		{
			return;
		}

		err = gpio_pin_configure(gpio_dev, input_gpio[i], GPIO_INPUT | GPIO_PULL_DOWN);
		if (err < 0)
		{
			return;
		}
	}
}

/********************************************************************************
 * Define the callback function
 ********************************************************************************/
void motion_detected(const struct device *dev, struct gpio_callback *cb, uint32_t pins)
{
	valve_status = VALVE_OPENED;
	gpio_pin_set(gpio_dev, WATER_VALVE, OPEN_VALVE);
	/* start periodic timer that expires once every second */
	k_timer_start(&my_timer, K_SECONDS(10), K_NO_WAIT);
}

/********************************************************************************
 * Define a variable of type static struct gpio_callback
 ********************************************************************************/
void my_expiry_function(struct k_timer *timer_id)
{
	valve_status = VALVE_CLOSED;
	gpio_pin_set(gpio_dev, WATER_VALVE, CLOSE_VALVE);
}

/************************************************************************
 *
 ************************************************************************/
void expiry_timer_fn(struct k_timer *dummy)
{
	LOG_INF("expiry timer");
	struct app_event evt = {
		.type = APP_EVENT_TIMER,
		.value = 1234,
	};
	//
	k_msgq_put(&app_msgq, &evt, K_NO_WAIT);
}

/********************************************************************************
 *
 ********************************************************************************/
static void lte_handler(const struct lte_lc_evt *const evt)
{
	switch (evt->type)
	{
	case LTE_LC_EVT_NW_REG_STATUS:
		if ((evt->nw_reg_status != LTE_LC_NW_REG_REGISTERED_HOME) &&
			(evt->nw_reg_status != LTE_LC_NW_REG_REGISTERED_ROAMING))
		{
			break;
		}
		LOG_INF("Network registration status: %s",
				evt->nw_reg_status == LTE_LC_NW_REG_REGISTERED_HOME ? "Connected - home network" : "Connected - roaming");
		k_sem_give(&lte_connected);
		break;
	case LTE_LC_EVT_RRC_UPDATE:
		LOG_INF("RRC mode: %s", evt->rrc_mode == LTE_LC_RRC_MODE_CONNECTED ? "Connected" : "Idle");
		break;
	default:
		break;
	}
}

/********************************************************************************
 *
 ********************************************************************************/
static void modem_configure(void)
{
	LOG_INF("Connecting to LTE network");

	int err = lte_lc_init_and_connect_async(lte_handler);
	if (err)
	{
		LOG_INF("Modem could not be configured, error: %d", err);
		return;
	}
	k_sem_take(&lte_connected, K_FOREVER);
	LOG_INF("Connected to LTE network");
	dk_set_led_on(DK_LED2);
}

/********************************************************************************
 *
 ********************************************************************************/
static void button_handler(uint32_t button_state, uint32_t has_changed)
{
	switch (has_changed)
	{
	case DK_BTN1_MSK:
		/* STEP 7.2 - When button 1 is pressed, call data_publish() to publish a message */
		if (button_state & DK_BTN1_MSK)
		{
			int err = data_publish(&client, MQTT_QOS_1_AT_LEAST_ONCE,
								   CONFIG_BUTTON_EVENT_PUBLISH_MSG, sizeof(CONFIG_BUTTON_EVENT_PUBLISH_MSG) - 1);
			if (err)
			{
				LOG_INF("Failed to send message, %d", err);
				return;
			}
		}
		break;
	}
}

/************************************************************************
 *
 ************************************************************************/
K_MSGQ_DEFINE(app_msgq, sizeof(struct app_event), APP_EVENT_QUEUE_SIZE, 4);

/********************************************************************************
 *
 ********************************************************************************/
void main(void)
{
	int err;
	uint32_t i;

	uint32_t connect_attempt = 0;
	struct app_event evt;

	configuer_all_outputs();
	configuer_all_inputs();
	if (dk_leds_init() != 0)
	{
		LOG_ERR("Failed to initialize the LED library");
	}
	k_msleep(SLEEP_TIME_MS * 10);
	LOG_INF("A Smart Water Tap Leakage Controller IoT Project/n/r");
	
	//
	for(i = 0; i < 5; i++)
	{
		blink_leds(SLEEP_TIME_QUOTA_S/2, SLEEP_TIME_QUOTA_S, LIGHTWELL_RED, 1);
		blink_leds(SLEEP_TIME_QUOTA_S/2, SLEEP_TIME_QUOTA_S, LIGHTWELL_GREEN, 1);
		blink_leds(SLEEP_TIME_QUOTA_S/2, SLEEP_TIME_QUOTA_S, LIGHTWELL_BLUE, 1);
	}
	
	/* Configure the interrupt on the button's pin */
	err = gpio_pin_interrupt_configure(gpio_dev, MOTION_DETECTOR, GPIO_INT_EDGE_TO_ACTIVE);
	if (err < 0)
	{
		return;
	}

	/* Initialize the static struct gpio_callback variable */
	gpio_init_callback(&motion_cb_data, motion_detected, BIT(13));
	/* Add the callback function by calling gpio_add_callback() */
	gpio_add_callback(gpio_dev, &motion_cb_data);

	//
	k_timer_init(&my_timer, my_expiry_function, NULL);
	k_timer_init(&main_timer, expiry_timer_fn, NULL);
	//

	LOG_INF("App Event Application started!");
	k_timer_start(&main_timer, K_SECONDS(1), K_NO_WAIT);

	while (true)
	{
		switch (evt.type)
		{
			k_msgq_get(&app_msgq, &evt, K_NO_WAIT);

			LOG_INF("Timer event type: %i", evt.type);
			case APP_EVENT_TIMER:
			{
				LOG_INF("Timer event value: %i", evt.value);
			}
			break;

			case APP_EVENT_ERROR:
			{
			}
			break;

			case APP_EVENT_SENSOR_DATA:
			{
			}
			break;

			default:
				LOG_INF("Timer event type: default");
			break;
		}

		if (valve_status == VALVE_CLOSED)
		{
			blink_leds(SLEEP_TIME_HALF_S, SLEEP_TIME_S, LIGHTWELL_GREEN, 1);
		}
		else if (valve_status == VALVE_OPENED)
		{
			blink_leds(SLEEP_TIME_QUOTA_S, SLEEP_TIME_HALF_S, LIGHTWELL_RED, 1);
			beep_buzzer(1, 1);
		}
		else
		{
		}
	}

	//
	modem_configure();

	if (dk_buttons_init(button_handler) != 0)
	{
		LOG_ERR("Failed to initialize the buttons library");
	}

	err = client_init(&client);
	if (err)
	{
		LOG_ERR("Failed to initialize MQTT client: %d", err);
		return;
	}

do_connect:
	if (connect_attempt++ > 0)
	{
		LOG_INF("Reconnecting in %d seconds...",
				CONFIG_MQTT_RECONNECT_DELAY_S);
		k_sleep(K_SECONDS(CONFIG_MQTT_RECONNECT_DELAY_S));
	}
	err = mqtt_connect(&client);
	if (err)
	{
		LOG_ERR("Error in mqtt_connect: %d", err);
		goto do_connect;
	}

	err = fds_init(&client, &fds);
	if (err)
	{
		LOG_ERR("Error in fds_init: %d", err);
		return;
	}

	while (1)
	{
		err = poll(&fds, 1, mqtt_keepalive_time_left(&client));
		if (err < 0)
		{
			LOG_ERR("Error in poll(): %d", errno);
			break;
		}

		err = mqtt_live(&client);
		if ((err != 0) && (err != -EAGAIN))
		{
			LOG_ERR("Error in mqtt_live: %d", err);
			break;
		}

		if ((fds.revents & POLLIN) == POLLIN)
		{
			err = mqtt_input(&client);
			if (err != 0)
			{
				LOG_ERR("Error in mqtt_input: %d", err);
				break;
			}
		}

		if ((fds.revents & POLLERR) == POLLERR)
		{
			LOG_ERR("POLLERR");
			break;
		}

		if ((fds.revents & POLLNVAL) == POLLNVAL)
		{
			LOG_ERR("POLLNVAL");
			break;
		}
	}

	LOG_INF("Disconnecting MQTT client");

	err = mqtt_disconnect(&client);
	if (err)
	{
		LOG_ERR("Could not disconnect MQTT client: %d", err);
	}
	goto do_connect;
}
```

## src/mqtt_connection.c
```c
/************************************************************************
 *
 ************************************************************************/
#include <stdio.h>
#include <string.h>

#include <zephyr/kernel.h>
#include <zephyr/random/rand32.h>
#include <zephyr/net/socket.h>
#include <zephyr/net/mqtt.h>
#include <nrf_modem_at.h>
#include <zephyr/logging/log.h>
#include <dk_buttons_and_leds.h>
#include "mqtt_connection.h"

/************************************************************************
 *
 ************************************************************************/
/* Buffers for MQTT client. */
static uint8_t rx_buffer[CONFIG_MQTT_MESSAGE_BUFFER_SIZE];
static uint8_t tx_buffer[CONFIG_MQTT_MESSAGE_BUFFER_SIZE];
static uint8_t payload_buf[CONFIG_MQTT_PAYLOAD_BUFFER_SIZE];

/* MQTT Broker details. */
static struct sockaddr_storage broker;

LOG_MODULE_DECLARE(a_smart_water_tap_v1);

/************************************************************************
 *
 ************************************************************************/
/**@brief Function to get the payload of recived data.
 */
static int get_received_payload(struct mqtt_client *c, size_t length)
{
	int ret;
	int err = 0;

	/* Return an error if the payload is larger than the payload buffer.
	 * Note: To allow new messages, we have to read the payload before returning.
	 */
	if (length > sizeof(payload_buf)) {
		err = -EMSGSIZE;
	}

	/* Truncate payload until it fits in the payload buffer. */
	while (length > sizeof(payload_buf)) {
		ret = mqtt_read_publish_payload_blocking(
				c, payload_buf, (length - sizeof(payload_buf)));
		if (ret == 0) {
			return -EIO;
		} else if (ret < 0) {
			return ret;
		}

		length -= ret;
	}

	ret = mqtt_readall_publish_payload(c, payload_buf, length);
	if (ret) {
		return ret;
	}

	return err;
}

/************************************************************************
 *
 ************************************************************************/
/**@brief Function to subscribe to the configured topic
 */
/* STEP 4 - Define the function subscribe() to subscribe to a specific topic.  */
static int subscribe(struct mqtt_client *const c)
{
	struct mqtt_topic subscribe_topic = {
		.topic = {
			.utf8 = CONFIG_MQTT_SUB_TOPIC,
			.size = strlen(CONFIG_MQTT_SUB_TOPIC)
		},
		.qos = MQTT_QOS_1_AT_LEAST_ONCE
	};

	const struct mqtt_subscription_list subscription_list = {
		.list = &subscribe_topic,
		.list_count = 1,
		.message_id = 1234
	};

	LOG_INF("Subscribing to: %s len %u", CONFIG_MQTT_SUB_TOPIC,
		(unsigned int)strlen(CONFIG_MQTT_SUB_TOPIC));

	return mqtt_subscribe(c, &subscription_list);
}

/************************************************************************
 *
 ************************************************************************/
/**@brief Function to print strings without null-termination
 */
static void data_print(uint8_t *prefix, uint8_t *data, size_t len)
{
	char buf[len + 1];

	memcpy(buf, data, len);
	buf[len] = 0;
	LOG_INF("%s%s", (char *)prefix, (char *)buf);
}

/************************************************************************
 *
 ************************************************************************/
/**@brief Function to publish data on the configured topic
 */
/* STEP 7.1 - Define the function data_publish() to publish data */
int data_publish(struct mqtt_client *c, enum mqtt_qos qos,
	uint8_t *data, size_t len)
{
	struct mqtt_publish_param param;

	param.message.topic.qos = qos;
	param.message.topic.topic.utf8 = CONFIG_MQTT_PUB_TOPIC;
	param.message.topic.topic.size = strlen(CONFIG_MQTT_PUB_TOPIC);
	param.message.payload.data = data;
	param.message.payload.len = len;
	param.message_id = sys_rand32_get();
	param.dup_flag = 0;
	param.retain_flag = 0;

	data_print("Publishing: ", data, len);
	LOG_INF("to topic: %s len: %u",
		CONFIG_MQTT_PUB_TOPIC,
		(unsigned int)strlen(CONFIG_MQTT_PUB_TOPIC));

	return mqtt_publish(c, &param);
}

/************************************************************************
 *
 ************************************************************************/
/**@brief MQTT client event handler
 */
void mqtt_evt_handler(struct mqtt_client *const c,
		      const struct mqtt_evt *evt)
{
	int err;

	switch (evt->type) {
	case MQTT_EVT_CONNACK:
	/* STEP 5 - Subscribe to the topic CONFIG_MQTT_SUB_TOPIC when we have a successful connection */
		if (evt->result != 0) {
			LOG_ERR("MQTT connect failed: %d", evt->result);
			break;
		}

		LOG_INF("MQTT client connected");
		subscribe(c);
		break;

	case MQTT_EVT_DISCONNECT:
		LOG_INF("MQTT client disconnected: %d", evt->result);
		break;

	case MQTT_EVT_PUBLISH:
	/* STEP 6 - Listen to published messages received from the broker and extract the message */
	{
		/* STEP 6.1 - Extract the payload */
		const struct mqtt_publish_param *p = &evt->param.publish;
		//Print the length of the recived message 
		LOG_INF("MQTT PUBLISH result=%d len=%d",
			evt->result, p->message.payload.len);

		//Extract the data of the recived message 
		err = get_received_payload(c, p->message.payload.len);
		
		//Send acknowledgment to the broker on receiving QoS1 publish message 
		if (p->message.topic.qos == MQTT_QOS_1_AT_LEAST_ONCE) {
			const struct mqtt_puback_param ack = {
				.message_id = p->message_id
			};

			/* Send acknowledgment. */
			mqtt_publish_qos1_ack(c, &ack);
		}

		/* STEP 6.2 - On successful extraction of data */
		if (err >= 0) {
			data_print("Received: ", payload_buf, p->message.payload.len);
			// Control the LED 
			if(strncmp(payload_buf,CONFIG_TURN_LED_ON_CMD,sizeof(CONFIG_TURN_LED_ON_CMD)-1) == 0){
				dk_set_led_on(LED_CONTROL_OVER_MQTT);
			}
			else if(strncmp(payload_buf,CONFIG_TURN_LED_OFF_CMD,sizeof(CONFIG_TURN_LED_OFF_CMD)-1) == 0){
				dk_set_led_off(LED_CONTROL_OVER_MQTT);
			}
		/* STEP 6.3 - On failed extraction of data */
		// Payload buffer is smaller than the received data 
		} else if (err == -EMSGSIZE) {
			LOG_ERR("Received payload (%d bytes) is larger than the payload buffer size (%d bytes).",
				p->message.payload.len, sizeof(payload_buf));
		// Failed to extract data, disconnect 
		} else {
			LOG_ERR("get_received_payload failed: %d", err);
			LOG_INF("Disconnecting MQTT client...");

			err = mqtt_disconnect(c);
			if (err) {
				LOG_ERR("Could not disconnect: %d", err);
			}
		}
	} break;

	case MQTT_EVT_PUBACK:
		if (evt->result != 0) {
			LOG_ERR("MQTT PUBACK error: %d", evt->result);
			break;
		}

		LOG_INF("PUBACK packet id: %u", evt->param.puback.message_id);
		break;

	case MQTT_EVT_SUBACK:
		if (evt->result != 0) {
			LOG_ERR("MQTT SUBACK error: %d", evt->result);
			break;
		}

		LOG_INF("SUBACK packet id: %u", evt->param.suback.message_id);
		break;

	case MQTT_EVT_PINGRESP:
		if (evt->result != 0) {
			LOG_ERR("MQTT PINGRESP error: %d", evt->result);
		}
		break;

	default:
		LOG_INF("Unhandled MQTT event type: %d", evt->type);
		break;
	}
}

/************************************************************************
 *
 ************************************************************************/
/**@brief Resolves the configured hostname and
 * initializes the MQTT broker structure
 */
static int broker_init(void)
{
	int err;
	struct addrinfo *result;
	struct addrinfo *addr;
	struct addrinfo hints = {
		.ai_family = AF_INET,
		.ai_socktype = SOCK_STREAM
	};

	err = getaddrinfo(CONFIG_MQTT_BROKER_HOSTNAME, NULL, &hints, &result);
	if (err) {
		LOG_ERR("getaddrinfo failed: %d", err);
		return -ECHILD;
	}

	addr = result;

	/* Look for address of the broker. */
	while (addr != NULL) {
		/* IPv4 Address. */
		if (addr->ai_addrlen == sizeof(struct sockaddr_in)) {
			struct sockaddr_in *broker4 =
				((struct sockaddr_in *)&broker);
			char ipv4_addr[NET_IPV4_ADDR_LEN];

			broker4->sin_addr.s_addr =
				((struct sockaddr_in *)addr->ai_addr)
				->sin_addr.s_addr;
			broker4->sin_family = AF_INET;
			broker4->sin_port = htons(CONFIG_MQTT_BROKER_PORT);

			inet_ntop(AF_INET, &broker4->sin_addr.s_addr,
				  ipv4_addr, sizeof(ipv4_addr));
			LOG_INF("IPv4 Address found %s", (char *)(ipv4_addr));

			break;
		} else {
			LOG_ERR("ai_addrlen = %u should be %u or %u",
				(unsigned int)addr->ai_addrlen,
				(unsigned int)sizeof(struct sockaddr_in),
				(unsigned int)sizeof(struct sockaddr_in6));
		}

		addr = addr->ai_next;
	}

	/* Free the address. */
	freeaddrinfo(result);

	return err;
}

/************************************************************************
 *
 ************************************************************************/
/* Function to get the client id */
static const uint8_t* client_id_get(void)
{
	static uint8_t client_id[MAX(sizeof(CONFIG_MQTT_CLIENT_ID),
				     CLIENT_ID_LEN)];

	if (strlen(CONFIG_MQTT_CLIENT_ID) > 0) {
		snprintf(client_id, sizeof(client_id), "%s",
			 CONFIG_MQTT_CLIENT_ID);
		goto exit;
	}

	char imei_buf[CGSN_RESPONSE_LENGTH + 1];
	int err;

	err = nrf_modem_at_cmd(imei_buf, sizeof(imei_buf), "AT+CGSN");
	if (err) {
		LOG_ERR("Failed to obtain IMEI, error: %d", err);
		goto exit;
	}

	imei_buf[IMEI_LEN] = '\0';

	snprintf(client_id, sizeof(client_id), "nrf-%.*s", IMEI_LEN, imei_buf);

exit:
	LOG_DBG("client_id = %s", (char *)(client_id));

	return client_id;
}

/************************************************************************
 *
 ************************************************************************/
/**@brief Initialize the MQTT client structure
 */
/* STEP 3 - Define the function client_init() to initialize the MQTT client instance.  */
int client_init(struct mqtt_client *client)
{
	int err;
	/* Initializes the client instance. */
	mqtt_client_init(client);

	/* Resolves the configured hostname and initializes the MQTT broker structure */
	err = broker_init();
	if (err) {
		LOG_ERR("Failed to initialize broker connection");
		return err;
	}

	/* MQTT client configuration */
	client->broker = &broker;
	client->evt_cb = mqtt_evt_handler;
	client->client_id.utf8 = client_id_get();
	client->client_id.size = strlen(client->client_id.utf8);
	client->password = NULL;
	client->user_name = NULL;
	client->protocol_version = MQTT_VERSION_3_1_1;

	/* MQTT buffers configuration */
	client->rx_buf = rx_buffer;
	client->rx_buf_size = sizeof(rx_buffer);
	client->tx_buf = tx_buffer;
	client->tx_buf_size = sizeof(tx_buffer);

	/* We are not using TLS in Exercise 1 */
	client->transport.type = MQTT_TRANSPORT_NON_SECURE;


	return err;
}

/************************************************************************
 *
 ************************************************************************/
/**@brief Initialize the file descriptor structure used by poll.
 */
int fds_init(struct mqtt_client *c, struct pollfd *fds)
{
	if (c->transport.type == MQTT_TRANSPORT_NON_SECURE) {
		fds->fd = c->transport.tcp.sock;
	} else {
		return -ENOTSUP;
	}

	fds->events = POLLIN;

	return 0;
}

/************************************************************************
 *
 ************************************************************************/
```

## src/mqtt_connection.h
```c
/************************************************************************
 *
 ************************************************************************/
#ifndef _MQTTCONNECTION_H_
#define _MQTTCONNECTION_H_

/************************************************************************
 *
 ************************************************************************/
#define LED_CONTROL_OVER_MQTT          DK_LED1 /*The LED to control over MQTT*/
#define IMEI_LEN 15
#define CGSN_RESPONSE_LENGTH (IMEI_LEN + 6 + 1) /* Add 6 for \r\nOK\r\n and 1 for \0 */
#define CLIENT_ID_LEN sizeof("nrf-") + IMEI_LEN

/************************************************************************
 *
 ************************************************************************/
/**@brief Initialize the MQTT client structure
 */
int client_init(struct mqtt_client *client);

/**@brief Initialize the file descriptor structure used by poll.
 */
int fds_init(struct mqtt_client *c, struct pollfd *fds);

/**@brief Function to publish data on the configured topic
 */
int data_publish(struct mqtt_client *c, enum mqtt_qos qos,
	uint8_t *data, size_t len);

#endif /* _CONNECTION_H_ */
/************************************************************************
 *
 ************************************************************************/
```
